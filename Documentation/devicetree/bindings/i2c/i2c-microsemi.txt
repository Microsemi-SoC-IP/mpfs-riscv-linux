## Documentation/devicetree/bindings/i2c/i2c-microsemi.txt
```
* Microsemi I2C

Required properties :

 - compatible : should be "microsemi,ms-pf-mss-i2c"
 - reg : Offset and length of the register set for the device
 - interrupts : <IRQ> where IRQ is the interrupt number.

Recommended properties :

 - clock-frequency : desired I2C bus clock frequency in Hz.

Examples :

	i2c@2000100000 {
		#address-cells = <1>;
		#size-cells = <0>;
		compatible = "microsemi,ms-pf-mss-i2c";
		reg = <0x20 0x00100000 0x0 0x1000>;
		interrupts = <32>;
		clock-frequency = <400000>;
	};

	i2c@1120000 {
		#address-cells = <1>;
		#size-cells = <0>;
		compatible = "microsemi,ms-pf-mss-i2c";
		reg = <0x20 0x00100000 0x0 0x1000>;
		interrupts = <32>;
		clock-frequency = <400000>;

		at24@0 {
			compatible = "at24,24c16";
			pagesize=<16>;
			reg = <0x50>;
			status = "okay";
		};
	};
```

## Documentation/devicetree/bindings/spi/spi-microsemi-qspi.txt
```
Microsemi MSS QSPI master

Required properties:
- compatible: should be "microsemi,ms-pf-mss-qspi"
- #address-cells: see spi-bus.txt
- #size-cells: see spi-bus.txt
- reg: address and length of the spi master registers
- interrupts: should contain one interrupt
- clocks: spi clock phandle
- num-cs: see spi-bus.txt

Examples:

L54: spi@2000400000 {
        compatible = "microsemi,ms-pf-mss-qspi";
        interrupt-parent = <&L4>;
        interrupts = <32>;
        reg = <0x20 0x00400000 0 0x1000>;
        clocks = <&xclk 0>;
        spi-max-frequency = <25000000>;
        #address-cells = <1>;
        #size-cells = <0>;
        num-cs = <1>;
        status = "okay";
};
```

## Documentation/devicetree/bindings/spi/spi-microsemi.txt
```
Microsemi MSS SPI master

Required properties:
- compatible: should be "microsemi,ms-pf-mss-spi"
- #address-cells: see spi-bus.txt
- #size-cells: see spi-bus.txt
- reg: address and length of the spi master registers
- interrupts: should contain one interrupt
- clocks: spi clock phandle
- num-cs: see spi-bus.txt

Examples:

L54: spi@2000107000 {
        compatible = "microsemi,ms-pf-mss-spi";
        interrupt-parent = <&L4>;
        interrupts = <32>;
        reg = <0x20 0x00107000 0 0x1000>;
        clocks = <&xclk 0>;
        spi-max-frequency = <25000000>;
        #address-cells = <1>;
        #size-cells = <0>;
        num-cs = <8>;
        status = "okay";
};

L54: spi@2000107000 {
        compatible = "microsemi,ms-pf-mss-spi";
        interrupt-parent = <&L4>;
        interrupts = <32>;
        reg = <0x20 0x00107000 0 0x1000>;
        clocks = <&xclk 0>;
        spi-max-frequency = <25000000>;
        #address-cells = <1>;
        #size-cells = <0>;
        num-cs = <8>;
        status = "okay";
        spi-flash@0 {
                #address-cells = <1>;
                #size-cells = <1>;
                compatible = "atmel,at25df321a", "jedec,spi-nor";
                spi-max-frequency = <17000000>;
                reg = <0>; /* chip-select */
                spi-cpha;
                spi-cpol;
                status = "okay";
        };
};
```

## arch/riscv/mach-riscvpc/Kconfig
```kconfig
# SPDX-License-Identifier: GPL-2.0
config ARCH_RISCVPC
	bool "Microsemi RISCVPC platform"
	depends on RISCV
	help
	  Support for Microsemi RISCVPC platform
```
